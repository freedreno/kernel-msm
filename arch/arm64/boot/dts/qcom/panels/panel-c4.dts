// SPDX-License-Identifier: BSD-3-Clause
/*
 * Panel overlay for panel-id 0xc4
 *
 * Copyright (c) 2019, Linaro Ltd.
 */

/dts-v1/;
/plugin/;
/ {
	fragment@0 {
		target-path = "/panel";
		__overlay__ {
			compatible = "boe,nv133fhm-n61";
		};
	};
};
